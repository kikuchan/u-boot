## configs/magicx_mini_zero28_a133p_defconfig
```kconfig
CONFIG_ARM=y
CONFIG_ARCH_SUNXI=y
CONFIG_DEFAULT_DEVICE_TREE="allwinner/sun50i-a133p-magicx-minizero28"
CONFIG_SPL=y

CONFIG_DRAM_SUNXI_DX_ODT=0x3030303
CONFIG_DRAM_SUNXI_DX_DRI=0xc0c0c0c
CONFIG_DRAM_SUNXI_CA_DRI=0x1919
CONFIG_DRAM_SUNXI_PARA0=0x12131615
CONFIG_DRAM_SUNXI_PARA1=0x610a
CONFIG_DRAM_SUNXI_PARA2=0x8000000
CONFIG_DRAM_SUNXI_MR0=0x520
CONFIG_DRAM_SUNXI_MR1=0x601
CONFIG_DRAM_SUNXI_MR2=0x8
CONFIG_DRAM_SUNXI_MR3=0x0
CONFIG_DRAM_SUNXI_MR5=0x400
CONFIG_DRAM_SUNXI_MR6=0x862
CONFIG_DRAM_SUNXI_TPR10=0x2f7777
CONFIG_DRAM_SUNXI_TPR11=0xe0f1613
CONFIG_DRAM_SUNXI_TPR12=0xd0c1311
CONFIG_DRAM_SUNXI_TPR13=0x7501
CONFIG_DRAM_SUNXI_TPR14=0x19191c1c
CONFIG_DRAM_CLK=0x318

CONFIG_MACH_SUN50I_A133=y
CONFIG_SUNXI_DRAM_A133_DDR4=y
CONFIG_R_I2C_ENABLE=y
CONFIG_SPL_SPI_SUNXI=y
CONFIG_SPL_I2C=y
CONFIG_SPL_SYS_I2C_LEGACY=y
CONFIG_SYS_I2C_MVTWSI=y
CONFIG_SYS_I2C_SLAVE=0x7f
CONFIG_SYS_I2C_SPEED=400000
CONFIG_REGULATOR_AXP=y
CONFIG_AXP717_POWER=y
CONFIG_AXP_DCDC3_VOLT=1200
```
